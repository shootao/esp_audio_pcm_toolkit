## Kconfig.projbuild
```kconfig
menu "ESP Audio PCM Toolkit"

    choice ESP_AUDIO_PCM_TRANSPORT
        prompt "PCM stream transport"
        default ESP_AUDIO_PCM_TRANSPORT_USB
        help
            Select the transport used for PCM streaming and remote control commands.

        config ESP_AUDIO_PCM_TRANSPORT_USB
            bool "USB Serial/JTAG"
        config ESP_AUDIO_PCM_TRANSPORT_UART
            bool "UART"
        config ESP_AUDIO_PCM_TRANSPORT_TCP
            bool "TCP (device client -> PC server)"
        config ESP_AUDIO_PCM_TRANSPORT_UDP
            bool "UDP (device client -> PC server)"
    endchoice

    config ESP_AUDIO_PCM_NET_SERVER_IP
        string "PC monitor server IP"
        default "192.168.4.2"
        depends on ESP_AUDIO_PCM_TRANSPORT_TCP || ESP_AUDIO_PCM_TRANSPORT_UDP
        help
            IPv4 address of the PC running pcm_monitor bridge (TCP/UDP server).

    config ESP_AUDIO_PCM_TCP_PORT
        int "TCP server port"
        default 8766
        range 1024 65535
        depends on ESP_AUDIO_PCM_TRANSPORT_TCP

    config ESP_AUDIO_PCM_UDP_PCM_PORT
        int "UDP PCM port (send to PC server)"
        default 8766
        range 1024 65535
        depends on ESP_AUDIO_PCM_TRANSPORT_UDP

    config ESP_AUDIO_PCM_UDP_LOCAL_PORT
        int "UDP local bind port (0 = auto)"
        default 0
        range 0 65535
        depends on ESP_AUDIO_PCM_TRANSPORT_UDP
        help
            Port bound on device for receiving control commands from PC.
            Use 0 to let the stack assign an ephemeral port.

    config ESP_AUDIO_PCM_NET_CONNECT_TIMEOUT_MS
        int "Network connect/open timeout (ms)"
        default 5000
        range 1000 60000
        depends on ESP_AUDIO_PCM_TRANSPORT_TCP || ESP_AUDIO_PCM_TRANSPORT_UDP

    config ESP_AUDIO_PCM_TCP_TX_BUF_SIZE
        int "TCP TX ring buffer size (bytes, PSRAM preferred)"
        default 1048576
        range 4096 4194304
        depends on ESP_AUDIO_PCM_TRANSPORT_TCP
        help
            Application-level send ring for TCP PCM. When SPIRAM is enabled and
            initialized, the buffer is allocated from PSRAM (~1 MiB default).
            Smooths WiFi/TCP backpressure and reduces dropouts. Without PSRAM,
            a smaller internal-RAM fallback is used.

    config ESP_AUDIO_PCM_USB_RX_BUF_SIZE
        int "USB RX buffer size"
        default 256
        depends on ESP_AUDIO_PCM_TRANSPORT_USB

    config ESP_AUDIO_PCM_USB_TX_BUF_SIZE
        int "USB TX buffer size"
        default 4096
        depends on ESP_AUDIO_PCM_TRANSPORT_USB

    config ESP_AUDIO_PCM_UART_PORT
        int "UART port number"
        default 1

    config ESP_AUDIO_PCM_UART_TX_PIN
        int "UART TX GPIO"
        default 17

    config ESP_AUDIO_PCM_UART_RX_PIN
        int "UART RX GPIO"
        default 18

    config ESP_AUDIO_PCM_UART_BAUD
        int "UART baud rate"
        default 921600

    config ESP_AUDIO_PCM_UART_RX_BUF_SIZE
        int "UART RX buffer size"
        default 256

    config ESP_AUDIO_PCM_UART_TX_BUF_SIZE
        int "UART TX buffer size"
        default 4096

endmenu
```

## examples/basic_example/main/Kconfig.projbuild
```kconfig
menu "Basic Example"

    choice BASIC_EXAMPLE_RECORD_CHANNELS
        prompt "Record channel count (PCM to PC)"
        default BASIC_EXAMPLE_RECORD_CHANNELS_4
        help
            Must match PC monitor Channels setting.

        config BASIC_EXAMPLE_RECORD_CHANNELS_3
            bool "3 channels"
        config BASIC_EXAMPLE_RECORD_CHANNELS_4
            bool "4 channels"
    endchoice

    config BASIC_EXAMPLE_RECORD_CHANNELS
        int
        default 3 if BASIC_EXAMPLE_RECORD_CHANNELS_3
        default 4 if BASIC_EXAMPLE_RECORD_CHANNELS_4

    config BASIC_EXAMPLE_DEFAULT_PLAY_VOL
        int "Default playback volume (0-100)"
        range 0 100
        default 70

    config BASIC_EXAMPLE_DEFAULT_MIC_GAIN
        int "Default mic gain in dB (0-36)"
        range 0 36
        default 30

    config BASIC_EXAMPLE_WIFI_SSID
        string "WiFi SSID"
        default "myssid"
        depends on ESP_AUDIO_PCM_TRANSPORT_TCP || ESP_AUDIO_PCM_TRANSPORT_UDP

    config BASIC_EXAMPLE_WIFI_PASSWORD
        string "WiFi password"
        default "mypassword"
        depends on ESP_AUDIO_PCM_TRANSPORT_TCP || ESP_AUDIO_PCM_TRANSPORT_UDP

    config BASIC_EXAMPLE_WIFI_MAX_RETRY
        int "WiFi connect max retry"
        default 10
        range 1 100
        depends on ESP_AUDIO_PCM_TRANSPORT_TCP || ESP_AUDIO_PCM_TRANSPORT_UDP

    config BASIC_EXAMPLE_WIFI_CONNECT_TIMEOUT_MS
        int "WiFi connect timeout (ms)"
        default 15000
        range 3000 120000
        depends on ESP_AUDIO_PCM_TRANSPORT_TCP || ESP_AUDIO_PCM_TRANSPORT_UDP

    config RECORD_CHANNELS
        int
        default BASIC_EXAMPLE_RECORD_CHANNELS

endmenu
```

## examples/basic_example/sdkconfig.defaults
```kconfig
CONFIG_IDF_TARGET="esp32s3"

# Console on UART0; USB Serial/JTAG used for PCM when transport=USB.
CONFIG_ESP_CONSOLE_UART_DEFAULT=y

# Default PCM transport (override in menuconfig).
CONFIG_ESP_AUDIO_PCM_TRANSPORT_USB=y
```
